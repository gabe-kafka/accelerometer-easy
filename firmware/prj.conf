## CMakeLists.txt
```
cmake_minimum_required(VERSION 3.20.0)
find_package(Zephyr REQUIRED HINTS $ENV{ZEPHYR_BASE})
project(hello_thingy91x)

target_sources(app PRIVATE src/main.c src/power.c src/transport.c)
target_include_directories(app PRIVATE include)
```

## prj.conf
```kconfig
# Thingy:91 X — Accelerometer + LTE-M Demo
CONFIG_SERIAL=y
CONFIG_CONSOLE=y
CONFIG_PRINTK=y

# Serial console via SEGGER RTT (over J-Link SWD).
# Dev loop runs over J-Link; bridge / USB-CDC is not required.
CONFIG_UART_CONSOLE=n
CONFIG_USE_SEGGER_RTT=y
CONFIG_RTT_CONSOLE=y

# Accelerometer (ADXL367 on I2C2)
CONFIG_I2C=y
CONFIG_SENSOR=y
CONFIG_ADXL367=y

# Modem
CONFIG_NRF_MODEM_LIB=y
CONFIG_LTE_LINK_CONTROL=y
CONFIG_MODEM_INFO=y

# Networking (offloaded to modem)
CONFIG_NETWORKING=y
CONFIG_NET_NATIVE=n
CONFIG_NET_SOCKETS=y
CONFIG_NET_SOCKETS_OFFLOAD=y

# nPM1300 PMIC / battery monitoring
CONFIG_MFD=y
CONFIG_REGULATOR=y

# MCUboot image confirmation
CONFIG_FLASH=y
CONFIG_FLASH_MAP=y
CONFIG_STREAM_FLASH=y
CONFIG_IMG_MANAGER=y
CONFIG_MCUBOOT_IMG_MANAGER=y

# HTTPS POST to Supabase
CONFIG_REST_CLIENT=y
CONFIG_REST_CLIENT_LOG_LEVEL_INF=y
CONFIG_MODEM_KEY_MGMT=y
CONFIG_DATE_TIME=y
CONFIG_POSIX_API=y
CONFIG_LOG=y

# Memory
CONFIG_HEAP_MEM_POOL_SIZE=16384
CONFIG_MAIN_STACK_SIZE=16384
```

## boards/thingy91x_nrf9151_ns.overlay
```dts
/* Enable the onboard ADXL367 accelerometer (I2C2, addr 0x1d) */

&accelerometer_lp {
	status = "okay";
};
```

## src/main.c
```c
#include <zephyr/kernel.h>
#include <zephyr/device.h>
#include <zephyr/drivers/i2c.h>

#include <modem/nrf_modem_lib.h>
#include <modem/lte_lc.h>
#include <modem/modem_info.h>
#include <nrf_modem_at.h>

static const char *reg_status_to_str(enum lte_lc_nw_reg_status s)
{
	switch (s) {
	case LTE_LC_NW_REG_NOT_REGISTERED:      return "NOT_REGISTERED";
	case LTE_LC_NW_REG_REGISTERED_HOME:     return "REGISTERED_HOME";
	case LTE_LC_NW_REG_SEARCHING:           return "SEARCHING";
	case LTE_LC_NW_REG_REGISTRATION_DENIED: return "REGISTRATION_DENIED";
	case LTE_LC_NW_REG_UNKNOWN:             return "UNKNOWN";
	case LTE_LC_NW_REG_REGISTERED_ROAMING:  return "REGISTERED_ROAMING";
	case LTE_LC_NW_REG_UICC_FAIL:           return "UICC_FAIL";
	default:                                return "?";
	}
}

static void lte_handler(const struct lte_lc_evt *const evt)
{
	switch (evt->type) {
	case LTE_LC_EVT_NW_REG_STATUS:
		printk("LTE: reg=%s\n", reg_status_to_str(evt->nw_reg_status));
		break;
	case LTE_LC_EVT_LTE_MODE_UPDATE:
		printk("LTE: mode=%s\n",
		       evt->lte_mode == LTE_LC_LTE_MODE_LTEM  ? "LTE-M" :
		       evt->lte_mode == LTE_LC_LTE_MODE_NBIOT ? "NB-IoT" : "NONE");
		break;
	case LTE_LC_EVT_RRC_UPDATE:
		printk("LTE: RRC=%s\n",
		       evt->rrc_mode == LTE_LC_RRC_MODE_CONNECTED ? "CONNECTED" : "IDLE");
		break;
	case LTE_LC_EVT_CELL_UPDATE:
		printk("LTE: cell=%u TAC=%u\n", evt->cell.id, evt->cell.tac);
		break;
	default:
		break;
	}
}

#include <zephyr/dfu/mcuboot.h>

#include "power.h"
#include "transport.h"

/* ADXL367 register addresses */
#define ADXL367_STATUS         0x0Bu
#define ADXL367_FIFO_ENTRIES_L 0x0Cu
#define ADXL367_FIFO_ENTRIES_H 0x0Du
#define ADXL367_X_DATA_H       0x0Eu
#define ADXL367_I2C_FIFO_DATA  0x18u
#define ADXL367_DATA_RDY       BIT(0)
#define ADXL367_FIFO_CONTROL   0x28u
#define ADXL367_FILTER_CTL     0x2Cu
#define ADXL367_POWER_CTL      0x2Du
#define ADXL367_ADC_CTL        0x3Cu

/* FIFO + ODR config */
#define FIFO_MODE_STREAM       0x02u
#define FILTER_25HZ_2G         0x01u  /* ±2g, 25 Hz ODR */
#define POWER_MEAS             0x02u
#define FIFO_14BIT_CHAN_ID     0xC0u

/* Batch sizing */
#define BATCH_SAMPLES          100
#define FIFO_MAX_SETS          170   /* 512 FIFO entries / 3 axes */
#define FIFO_RAW_BUF_SIZE      (FIFO_MAX_SETS * 6)
#define FIFO_DRAIN_MS          500
#define SAMPLE_QUEUE_LEN       4096  /* ~164 seconds at 25 Hz */
#define SAMPLE_THREAD_STACK    2048
#define SAMPLE_THREAD_PRIORITY 3
#define CHARGE_POLICY_TICK_MS  60000

/* I2C bus + address from device tree (ADXL367 @ 0x1d on I2C2) */
static const struct i2c_dt_spec accel_i2c = I2C_DT_SPEC_GET(DT_NODELABEL(accel));

/*
 * Read raw 14-bit accelerometer counts directly via I2C.
 * Bypasses the Zephyr ADXL367 sensor driver (which has a 10x scale
 * error in NCS v2.9) to get the rawest possible data.
 *
 * Output: signed 14-bit values in [-8192, +8191].
 * At ±2g range, 1 LSB ≈ 250 µg (per ADXL367 datasheet).
 */
static int read_accel_raw(int16_t *x, int16_t *y, int16_t *z)
{
	uint8_t status;
	uint8_t buf[6];
	int ret;

	/* Poll STATUS register until DATA_RDY */
	do {
		ret = i2c_reg_read_byte_dt(&accel_i2c, ADXL367_STATUS, &status);
		if (ret) {
			return ret;
		}
	} while (!(status & ADXL367_DATA_RDY));

	/* Burst read 6 bytes: X_H, X_L, Y_H, Y_L, Z_H, Z_L */
	ret = i2c_burst_read_dt(&accel_i2c, ADXL367_X_DATA_H, buf, 6);
	if (ret) {
		return ret;
	}

	/* Parse 14-bit signed values (high byte << 6 | low byte >> 2) */
	*x = ((int16_t)buf[0] << 6) | (buf[1] >> 2);
	if (*x & BIT(13)) {
		*x |= 0xC000; /* sign-extend bits 14-15 */
	}

	*y = ((int16_t)buf[2] << 6) | (buf[3] >> 2);
	if (*y & BIT(13)) {
		*y |= 0xC000;
	}

	*z = ((int16_t)buf[4] << 6) | (buf[5] >> 2);
	if (*z & BIT(13)) {
		*z |= 0xC000;
	}

	return 0;
}

/* FIFO buffers */
static struct accel_sample batch[BATCH_SAMPLES];
static struct accel_sample drain_buf[FIFO_MAX_SETS];
static uint8_t fifo_raw[FIFO_RAW_BUF_SIZE];
static struct k_thread sample_thread_data;
static K_THREAD_STACK_DEFINE(sample_thread_stack, SAMPLE_THREAD_STACK);
K_MSGQ_DEFINE(sample_queue, sizeof(struct accel_sample), SAMPLE_QUEUE_LEN, 4);
static atomic_t dropped_samples;

static int adxl367_fifo_init(void)
{
	int ret;

	ret = i2c_reg_write_byte_dt(&accel_i2c, ADXL367_POWER_CTL, 0x00);
	if (ret) { printk("ADXL367: standby failed: %d\n", ret); return ret; }
	k_msleep(10);

	ret = i2c_reg_write_byte_dt(&accel_i2c, ADXL367_FILTER_CTL, FILTER_25HZ_2G);
	if (ret) { printk("ADXL367: ODR failed: %d\n", ret); return ret; }

	ret = i2c_reg_write_byte_dt(&accel_i2c, ADXL367_ADC_CTL, FIFO_14BIT_CHAN_ID);
	if (ret) { printk("ADXL367: FIFO format failed: %d\n", ret); return ret; }

	ret = i2c_reg_write_byte_dt(&accel_i2c, ADXL367_FIFO_CONTROL, FIFO_MODE_STREAM);
	if (ret) { printk("ADXL367: FIFO failed: %d\n", ret); return ret; }

	ret = i2c_reg_write_byte_dt(&accel_i2c, ADXL367_POWER_CTL, POWER_MEAS);
	if (ret) { printk("ADXL367: meas failed: %d\n", ret); return ret; }

	printk("ADXL367: FIFO stream, 25 Hz, +/-2g\n");
	return 0;
}

static int16_t sign_extend_14(uint16_t raw)
{
	raw &= 0x3FFF;
	if (raw & BIT(13)) {
		raw |= 0xC000;
	}
	return (int16_t)raw;
}

static void decode_fifo_word(const uint8_t *raw, uint8_t *channel, int16_t *value)
{
	uint16_t word = ((uint16_t)raw[0] << 8) | raw[1];

	*channel = word >> 14;
	*value = sign_extend_14(word);
}

static int adxl367_drain_fifo(struct accel_sample *buf, int max_samples)
{
	uint8_t eh, el;
	int ret;
	struct accel_sample pending = { 0 };
	bool have_x = false;
	bool have_y = false;
	int out = 0;

	if (max_samples <= 0) return 0;

	ret = i2c_reg_read_byte_dt(&accel_i2c, ADXL367_FIFO_ENTRIES_H, &eh);
	if (ret) return ret;
	ret = i2c_reg_read_byte_dt(&accel_i2c, ADXL367_FIFO_ENTRIES_L, &el);
	if (ret) return ret;

	uint16_t entries = ((uint16_t)(eh & 0x03) << 8) | el;
	if (entries < 3) return 0;

	int read_entries = entries;
	int target_entries = (max_samples * 3) + 2;
	if (read_entries > target_entries) read_entries = target_entries;
	if (read_entries > FIFO_RAW_BUF_SIZE / 2) read_entries = FIFO_RAW_BUF_SIZE / 2;

	ret = i2c_burst_read_dt(&accel_i2c, ADXL367_I2C_FIFO_DATA,
				fifo_raw, read_entries * 2);
	if (ret) return ret;

	for (int i = 0; i < read_entries && out < max_samples; i++) {
		uint8_t channel;
		int16_t value;

		decode_fifo_word(&fifo_raw[i * 2], &channel, &value);

		switch (channel) {
		case 0:
			pending.x = value;
			have_x = true;
			have_y = false;
			break;
		case 1:
			if (have_x) {
				pending.y = value;
				have_y = true;
			}
			break;
		case 2:
			if (have_x && have_y) {
				pending.z = value;
				buf[out++] = pending;
				have_x = false;
				have_y = false;
			}
			break;
		default:
			have_x = false;
			have_y = false;
			break;
		}
	}

	return out;
}

static void queue_sample(const struct accel_sample *sample)
{
	while (k_msgq_put(&sample_queue, sample, K_NO_WAIT) != 0) {
		struct accel_sample discarded;

		if (k_msgq_get(&sample_queue, &discarded, K_NO_WAIT) != 0) {
			break;
		}
		atomic_inc(&dropped_samples);
	}
}

static void sample_thread(void *a, void *b, void *c)
{
	ARG_UNUSED(a);
	ARG_UNUSED(b);
	ARG_UNUSED(c);

	while (1) {
		int n = adxl367_drain_fifo(drain_buf, ARRAY_SIZE(drain_buf));

		if (n > 0) {
			for (int i = 0; i < n; i++) {
				queue_sample(&drain_buf[i]);
			}
			printk("FIFO: +%d queued=%u dropped=%ld\n",
			       n, k_msgq_num_used_get(&sample_queue),
			       atomic_get(&dropped_samples));
		}

		k_msleep(FIFO_DRAIN_MS);
	}
}

static int modem_connect(void)
{
	int err;
	char buf[128];

	printk("\n--- Modem bringup ---\n");

	printk("Initializing modem...\n");
	err = nrf_modem_lib_init();
	if (err) {
		printk("nrf_modem_lib_init failed: %d\n", err);
		return err;
	}
	printk("Modem initialized.\n");

	/* Visibility during attach: state transitions, mode, RRC, cell ID.
	 * Intentionally does NOT call modem_info or lte_lc_modem_events_enable
	 * — both can fault from the callback thread during attach. */
	lte_lc_register_handler(lte_handler);

	/* Provision TLS cert before LTE connect */
	err = transport_init();
	if (err) {
		printk("WARNING: transport_init failed: %d (POST will fail)\n", err);
	}

	/* Read SIM ICCID */
	err = nrf_modem_at_cmd(buf, sizeof(buf), "AT+CCID");
	if (err) {
		printk("AT+CCID failed: %d\n", err);
	} else {
		printk("SIM ICCID: %s", buf);
	}

	/* Read IMSI */
	err = nrf_modem_at_cmd(buf, sizeof(buf), "AT+CIMI");
	if (err) {
		printk("AT+CIMI failed: %d\n", err);
	} else {
		printk("IMSI: %s", buf);
	}

	printk("Connecting to LTE network (this may take 10-60 seconds)...\n");
	err = lte_lc_connect();
	if (err) {
		printk("lte_lc_connect failed: %d\n", err);
		return err;
	}
	printk("Connected to LTE!\n");

	/* Print signal strength */
	err = modem_info_init();
	if (err) {
		printk("modem_info_init failed: %d\n", err);
	} else {
		int rsrp_raw;

		err = modem_info_get_rsrp(&rsrp_raw);
		if (err) {
			printk("modem_info_get_rsrp failed: %d\n", err);
		} else {
			printk("RSRP: %d dBm\n", RSRP_IDX_TO_DBM(rsrp_raw));
		}
	}

	return 0;
}

/*
 * Force the modem offline then reconnect.  Called when a transport
 * operation fails, indicating the LTE link has dropped.
 *
 * lte_lc_offline() drives the modem to AT+CFUN=4, which tears down
 * any open sockets and deregisters from the network — ensuring
 * lte_lc_connect() performs a full re-registration rather than
 * returning immediately because the modem still thinks it's attached.
 *
 * Returns 0 on success, negative errno if reconnect fails.
 */
static int modem_reconnect(void)
{
	int err;

	printk("LTE link lost — reconnecting...\n");

	err = lte_lc_offline();
	if (err) {
		printk("lte_lc_offline failed: %d (continuing)\n", err);
	}

	k_msleep(1000);

	err = lte_lc_connect();
	if (err) {
		printk("lte_lc_connect failed: %d\n", err);
		return err;
	}

	printk("LTE reconnected.\n");

	/* Allow date_time to re-sync from network time */
	k_msleep(3000);

	return 0;
}

int main(void)
{
	printk("\n=== Thingy:91 X — Raw Accel + LTE + Supabase ===\n\n");

	/* Confirm MCUboot image so bootloader doesn't revert */
	boot_write_img_confirmed();

	/* --- Step 1: Accelerometer I2C bus --- */
	if (!i2c_is_ready_dt(&accel_i2c)) {
		printk("ERROR: ADXL367 I2C bus not ready!\n");
		return 0;
	}
	printk("ADXL367 I2C bus ready (addr 0x%02x).\n", accel_i2c.addr);

	/* --- Step 1b: Battery --- */
	if (power_init() != 0) {
		printk("WARNING: nPM1300 charger not ready\n");
	} else {
		int32_t bat_mv;
		uint8_t bat_pct;
		int32_t ibat_ma;

		if (power_read_battery(&bat_mv, &bat_pct) == 0) {
			printk("Battery: %d.%03d V  (%u %%)\n",
			       bat_mv / 1000, bat_mv % 1000, bat_pct);
		} else {
			printk("WARNING: battery read failed\n");
		}

		if (power_read_current(&ibat_ma) == 0) {
			const char *state = ibat_ma > 0 ? "charging"
					  : ibat_ma < 0 ? "discharging"
					  : "idle";
			printk("Battery current: %d mA (%s)\n", ibat_ma, state);
		} else {
			printk("WARNING: battery current read failed\n");
		}

		bool vbus_present;

		if (power_read_vbus(&vbus_present) == 0) {
			printk("VBUS: %s\n", vbus_present ? "present" : "absent");
		} else {
			printk("WARNING: VBUS read failed\n");
		}

		uint8_t chg_state;

		if (power_read_chg_state(&chg_state) == 0) {
			printk("chg_state: 0x%02x\n", chg_state);
		} else {
			printk("WARNING: chg_state read failed\n");
		}

		power_charge_policy_init();
	}

	/* Show a few raw readings at startup */
	for (int i = 0; i < 5; i++) {
		int16_t x, y, z;

		if (read_accel_raw(&x, &y, &z) == 0) {
			printk("Accel raw: x=%d  y=%d  z=%d  (counts)\n", x, y, z);
		} else {
			printk("Accel raw read failed\n");
		}
		k_msleep(100);
	}

	/* --- Step 2: LTE-M modem + TLS cert --- */
	modem_connect();

	/* Wait for date_time to sync from modem after LTE attach */
	printk("Waiting for time sync...\n");
	k_msleep(3000);

	/* --- Enable ADXL367 FIFO at 25 Hz --- */
	if (adxl367_fifo_init() != 0) {
		printk("ERROR: ADXL367 FIFO init failed!\n");
		return 0;
	}

	/* --- FIFO batch loop --- */
	printk("\n--- FIFO 25 Hz continuous -> batch of %d -> Supabase ---\n",
	       BATCH_SAMPLES);
	k_thread_create(&sample_thread_data, sample_thread_stack,
			K_THREAD_STACK_SIZEOF(sample_thread_stack),
			sample_thread, NULL, NULL, NULL,
			SAMPLE_THREAD_PRIORITY, 0, K_NO_WAIT);

	int batch_pos = 0;
	int64_t last_charge_tick = k_uptime_get();

	while (1) {
		if (k_uptime_get() - last_charge_tick >= CHARGE_POLICY_TICK_MS) {
			power_charge_policy_tick();
			last_charge_tick = k_uptime_get();
		}

		while (batch_pos < BATCH_SAMPLES &&
		       k_msgq_get(&sample_queue, &batch[batch_pos], K_NO_WAIT) == 0) {
			batch_pos++;
		}

		if (batch_pos >= BATCH_SAMPLES) {
			int32_t bat_mv = 0;
			uint8_t bat_pct = 0;
			int ret;

			power_read_battery(&bat_mv, &bat_pct);
			printk("Posting %d samples (bat %d.%03dV, %u%%)...\n",
			       batch_pos, bat_mv / 1000, bat_mv % 1000,
			       bat_pct);

			ret = transport_send_batch(batch, batch_pos, bat_pct);
			if (ret) {
				printk("POST failed (%d) — reconnecting\n",
				       ret);
				if (modem_reconnect() == 0) {
					transport_send_batch(batch, batch_pos,
							     bat_pct);
				}
			}

			batch_pos = 0;

		}

		k_msleep(100);
	}

	return 0;
}
```

## include/packet.h
```c
#ifndef PACKET_H
#define PACKET_H

#include <stdint.h>

typedef struct {
	char     node_id[16];       /* IMEI or HW serial */
	int64_t  timestamp_ms;      /* Unix epoch ms (UTC) */
	float    accel_rms[3];      /* X, Y, Z in mg */
	struct {
		uint8_t axis;       /* 0=X, 1=Y, 2=Z */
		float   freq_hz;
		float   mag_mg;
	} peaks[15];                /* Top 5 per axis x 3 axes */
	float    battery_v;
	uint8_t  battery_pct;       /* 0-100%, linear map 3.0-4.2V */
	float    temp_c;            /* ADXL362 onboard temp sensor */
	int8_t   rssi_dbm;
} feature_packet_t;

#endif /* PACKET_H */
```

## src/power.c
```c
#include "power.h"

#include <stdbool.h>
#include <zephyr/device.h>
#include <zephyr/drivers/i2c.h>
#include <zephyr/drivers/sensor.h>
#include <zephyr/drivers/sensor/npm1300_charger.h>
#include <zephyr/kernel.h>
#include <zephyr/sys/printk.h>

/* Charge policy: keep cell in a longevity-friendly 3.9–4.0 V band.
 * Trigger charging when VBAT falls below START, commit to DURATION, stop.
 * Safety-override continuous-charge when cell is dangerously low. */
#define CHARGE_START_MV    3900
#define CHARGE_FORCE_MV    4000
#define CHARGE_SAFETY_MV   3500
#define CHARGE_RESUME_MV   3800
#define CHARGE_DURATION_MS (20 * 60 * 1000)
#define LOW_VBAT_CONFIRM   3

static bool policy_active;
static bool safety_override;
static int64_t policy_start_ts;
static int low_vbat_streak;

/* nPM1300 charger node on the Thingy:91 X */
static const struct device *charger = DEVICE_DT_GET(DT_NODELABEL(npm1300_charger));

/* nPM1300 MFD parent at I²C addr 0x6b — for direct register reads not
 * exposed by the charger sensor driver (VBUS status, etc.). */
static const struct i2c_dt_spec pmic_i2c =
	I2C_DT_SPEC_GET(DT_NODELABEL(pmic_main));

struct soc_point {
	int32_t mv;
	uint8_t pct;
};

/* Field-facing usable battery estimate. The modem becomes unreliable around
 * 3.7 V on this hardware, so treat that as 0% usable capacity. */
static const struct soc_point soc_curve[] = {
	{4200, 100},
	{4100, 90},
	{4000, 80},
	{3920, 70},
	{3850, 60},
	{3790, 50},
	{3750, 40},
	{3710, 30},
	{3700, 0},
};

static uint8_t battery_pct_from_mv(int32_t mv)
{
	for (size_t i = 0; i < ARRAY_SIZE(soc_curve) - 1; i++) {
		const struct soc_point *hi = &soc_curve[i];
		const struct soc_point *lo = &soc_curve[i + 1];

		if (mv >= hi->mv) {
			return hi->pct;
		}

		if (mv >= lo->mv) {
			return lo->pct +
			       (uint8_t)(((mv - lo->mv) * (hi->pct - lo->pct)) /
					 (hi->mv - lo->mv));
		}
	}

	return 0;
}

int power_init(void)
{
	if (!device_is_ready(charger)) {
		return -ENODEV;
	}
	return 0;
}

int power_read_battery(int32_t *voltage_mv, uint8_t *pct)
{
	struct sensor_value val;
	int ret;

	ret = sensor_sample_fetch(charger);
	if (ret < 0) {
		return ret;
	}

	ret = sensor_channel_get(charger, SENSOR_CHAN_GAUGE_VOLTAGE, &val);
	if (ret < 0) {
		return ret;
	}

	/* Convert sensor_value (volts) to millivolts */
	int32_t mv = val.val1 * 1000 + val.val2 / 1000;
	*voltage_mv = mv;

	*pct = battery_pct_from_mv(mv);

	return 0;
}

int power_read_vbus(bool *present)
{
	/* nPM1300 VBUS_STATUS register: block 0x02, offset 0x07.
	 * Bit 0 = VBUSINPRESENT (valid VBUS supply detected). */
	uint8_t reg_addr[2] = { 0x02, 0x07 };
	uint8_t stat;
	int ret;

	if (!device_is_ready(pmic_i2c.bus)) {
		return -ENODEV;
	}

	ret = i2c_write_read_dt(&pmic_i2c, reg_addr, sizeof(reg_addr), &stat, 1);
	if (ret < 0) {
		return ret;
	}

	*present = (stat & 0x01) != 0;
	return 0;
}

int power_set_charging(bool enable)
{
	uint8_t buf[3] = {
		0x03,                              /* CHGR_BASE block */
		(uint8_t)(enable ? 0x04 : 0x05),  /* BCHGENABLESET / BCHGENABLECLR */
		0x01,
	};
	int ret;

	if (!device_is_ready(pmic_i2c.bus)) {
		return -ENODEV;
	}

	if (enable) {
		uint8_t err_clr[3] = {
			0x03,  /* CHGR_BASE block */
			0x00,  /* BCHGERRREASONCLR */
			0x01,
		};

		ret = i2c_write_dt(&pmic_i2c, err_clr, sizeof(err_clr));
		if (ret < 0) {
			return ret;
		}
	}

	return i2c_write_dt(&pmic_i2c, buf, sizeof(buf));
}

int power_charge_policy_init(void)
{
	int32_t mv;
	uint8_t pct;
	bool vbus_present = false;
	int ret;

	ret = power_read_battery(&mv, &pct);
	if (ret < 0) {
		return ret;
	}

	power_read_vbus(&vbus_present);

	if (vbus_present && mv < CHARGE_FORCE_MV) {
		policy_active = true;
		safety_override = false;
		policy_start_ts = k_uptime_get();
		power_set_charging(true);
		printk("Charge policy: USB present, bat=%dmV<4000, charger FORCED ON\n",
		       mv);
		return 0;
	}

	if (mv < CHARGE_SAFETY_MV) {
		safety_override = true;
		policy_active = true;
		policy_start_ts = k_uptime_get();
		power_set_charging(true);
		printk("Charge policy: SAFETY (bat=%dmV), charger ON\n", mv);
	} else if (mv < CHARGE_START_MV) {
		policy_active = true;
		policy_start_ts = k_uptime_get();
		power_set_charging(true);
		printk("Charge policy: bat=%dmV<3900, 20-min window\n", mv);
	} else {
		policy_active = false;
		power_set_charging(false);
		printk("Charge policy: bat=%dmV>=3900, charger OFF\n", mv);
	}
	return 0;
}

void power_charge_policy_tick(void)
{
	int32_t mv;
	uint8_t pct;
	bool vbus_present = false;

	if (power_read_battery(&mv, &pct) < 0) {
		return;
	}

	power_read_vbus(&vbus_present);

	if (vbus_present && mv < CHARGE_FORCE_MV) {
		policy_active = true;
		safety_override = false;
		policy_start_ts = k_uptime_get();
		power_set_charging(true);
		printk("Charge policy: USB present, bat=%dmV<4000, charger forced ON\n",
		       mv);
		return;
	}

	if (safety_override) {
		if (mv >= CHARGE_RESUME_MV) {
			safety_override = false;
			policy_active = true;
			policy_start_ts = k_uptime_get();
			printk("Charge policy: SAFETY cleared, 20-min window\n");
		}
		return;
	}

	if (policy_active) {
		if (k_uptime_get() - policy_start_ts >= CHARGE_DURATION_MS) {
			policy_active = false;
			power_set_charging(false);
			low_vbat_streak = 0;
			printk("Charge policy: 20-min window expired (bat=%dmV)\n", mv);
		}
		return;
	}

	if (mv < CHARGE_SAFETY_MV) {
		safety_override = true;
		policy_active = true;
		policy_start_ts = k_uptime_get();
		power_set_charging(true);
		printk("Charge policy: SAFETY triggered (bat=%dmV)\n", mv);
		return;
	}

	if (mv < CHARGE_START_MV) {
		if (++low_vbat_streak >= LOW_VBAT_CONFIRM) {
			policy_active = true;
			policy_start_ts = k_uptime_get();
			power_set_charging(true);
			low_vbat_streak = 0;
			printk("Charge policy: bat=%dmV<3900 (x%d), 20-min window\n",
			       mv, LOW_VBAT_CONFIRM);
		}
	} else {
		low_vbat_streak = 0;
	}
}

int power_read_chg_state(uint8_t *chg_state)
{
	struct sensor_value val;
	int ret;

	ret = sensor_sample_fetch(charger);
	if (ret < 0) {
		return ret;
	}

	ret = sensor_channel_get(charger, SENSOR_CHAN_NPM1300_CHARGER_STATUS, &val);
	if (ret < 0) {
		return ret;
	}

	*chg_state = (uint8_t)(val.val1 & 0xFF);
	return 0;
}

int power_read_current(int32_t *ibat_ma)
{
	struct sensor_value val;
	int ret;

	ret = sensor_sample_fetch(charger);
	if (ret < 0) {
		return ret;
	}

	ret = sensor_channel_get(charger, SENSOR_CHAN_GAUGE_AVG_CURRENT, &val);
	if (ret < 0) {
		return ret;
	}

	/*
	 * Handle both Zephyr sensor_value sign conventions for negatives,
	 * then negate: Nordic's nPM1300 driver returns + for discharging,
	 * - for charging. We expose the intuitive convention (+ = charging).
	 */
	int64_t ua = (int64_t)val.val1 * 1000000 + val.val2;
	*ibat_ma = -(int32_t)(ua / 1000);

	return 0;
}
```

## src/power.h
```c
#ifndef POWER_H
#define POWER_H

#include <stdbool.h>
#include <stdint.h>

/**
 * Initialize the power module (nPM1300 charger device).
 * Returns 0 on success, negative errno on failure.
 */
int power_init(void);

/**
 * Read battery voltage and compute percentage.
 * @param voltage_mv  Output: battery voltage in millivolts
 * @param pct         Output: battery percentage 0-100
 * Returns 0 on success, negative errno on failure.
 */
int power_read_battery(int32_t *voltage_mv, uint8_t *pct);

/**
 * Read instantaneous battery current.
 * Positive = charging (into battery), negative = discharging (out of battery).
 * @param ibat_ma  Output: battery current in mA
 * Returns 0 on success, negative errno on failure.
 */
int power_read_current(int32_t *ibat_ma);

/**
 * Read USB VBUS input status from the nPM1300.
 * @param present  Output: true if a valid VBUS supply is detected.
 * Returns 0 on success, negative errno on failure.
 */
int power_read_vbus(bool *present);

/**
 * Read nPM1300 charger status register (BCHGCHARGESTATUS) as a raw byte.
 * Bit layout: 0=BATTDETECTED 1=COMPLETED 2=TRICKLE 3=CC 4=CV 5=RECHARGE
 * 6=THERMAL_LIMIT 7=SUPPLEMENT. Decode intentionally lives off-device.
 * @param chg_state  Output: raw BCHGCHARGESTATUS byte
 * Returns 0 on success, negative errno on failure.
 */
int power_read_chg_state(uint8_t *chg_state);

/**
 * Enable or disable the nPM1300 charger at runtime via direct I2C write
 * to BCHGENABLESET (offset 0x04) or BCHGENABLECLR (offset 0x05).
 * Bypasses the NCS charger_charge_enable() API which secure-faults on 2.9.
 */
int power_set_charging(bool enable);

/**
 * Initialize the charge-policy state machine at boot based on current VBAT.
 * USB present and below 4.0 V: force charger on for recovery/debug.
 * Below 3.5 V: enter SAFETY (continuous charge until 3.8 V).
 * 3.5–3.9 V: enter CHARGING (20-min window).
 * ≥ 3.9 V: IDLE, charger disabled.
 */
int power_charge_policy_init(void);

/**
 * Evaluate the charge policy once.
 * Transitions: USB+VBAT<4.0V→FORCED ON, IDLE→CHARGING when VBAT<3.9V
 * confirmed on 3 consecutive ticks, CHARGING→IDLE when 20-min window expires,
 * SAFETY→CHARGING at 3.8 V, any→SAFETY when VBAT<3.5 V.
 */
void power_charge_policy_tick(void);

#endif /* POWER_H */
```

## src/transport.c
```c
#include <stdint.h>
#include <string.h>
#include <zephyr/kernel.h>
#include <modem/modem_key_mgmt.h>
#include <net/rest_client.h>
#include <zephyr/net/http/client.h>
#include <date_time.h>

#include "transport.h"

#define TLS_SEC_TAG	42
#define SUPABASE_HOST	"rcaglkgoyemcjaszaahu.supabase.co"
#define SUPABASE_URL	"/rest/v1/accel_batches"
#define SUPABASE_CONFIG_URL "/rest/v1/node_config"
#define SUPABASE_PORT	443

#define SUPABASE_ANON_KEY \
	"eyJhbGciOiJIUzI1NiIsInR5cCI6IkpXVCJ9." \
	"eyJpc3MiOiJzdXBhYmFzZSIsInJlZiI6InJjYWdsa2dveWVtY2phc3phYWh1Iiwicm9sZSI6ImFub24iLCJpYXQiOjE3NzE3MTcyNzcsImV4cCI6MjA4NzI5MzI3N30." \
	"m2lz6wQIlv9PfuT7_DU4HZoBcCnK_kzXtJOAI7b6UV4"

/* GlobalSign Root CA — trust anchor for Supabase (via Google Trust Services) */
static const char ca_cert[] = {
	#include "../certs/GlobalSignRootCA.pem"
};

/* Buffers */
static char body_buf[256];
static char batch_buf[16384];
static char resp_buf[2048];

int transport_init(void)
{
	int err;
	bool exists;

	printk("Provisioning TLS certificate (sec_tag %d)...\n", TLS_SEC_TAG);

	err = modem_key_mgmt_exists(TLS_SEC_TAG, MODEM_KEY_MGMT_CRED_TYPE_CA_CHAIN, &exists);
	if (err) {
		printk("modem_key_mgmt_exists failed: %d\n", err);
		return err;
	}

	if (exists) {
		int mismatch = modem_key_mgmt_cmp(TLS_SEC_TAG,
						  MODEM_KEY_MGMT_CRED_TYPE_CA_CHAIN,
						  ca_cert, sizeof(ca_cert));
		if (!mismatch) {
			printk("TLS certificate already provisioned.\n");
			return 0;
		}
		printk("TLS certificate mismatch, updating...\n");
		modem_key_mgmt_delete(TLS_SEC_TAG, MODEM_KEY_MGMT_CRED_TYPE_CA_CHAIN);
	}

	err = modem_key_mgmt_write(TLS_SEC_TAG, MODEM_KEY_MGMT_CRED_TYPE_CA_CHAIN,
				   ca_cert, sizeof(ca_cert));
	if (err) {
		printk("modem_key_mgmt_write failed: %d\n", err);
		return err;
	}

	printk("TLS certificate provisioned.\n");
	return 0;
}

int transport_send_reading(int16_t x_raw, int16_t y_raw, int16_t z_raw)
{
	int err;

	/* Build JSON body — raw 14-bit counts, no conversion */
	int len = snprintf(body_buf, sizeof(body_buf),
		"{\"x\":%d,\"y\":%d,\"z\":%d}",
		x_raw, y_raw, z_raw);

	if (len < 0 || len >= (int)sizeof(body_buf)) {
		printk("JSON body too large\n");
		return -ENOMEM;
	}

	/* REST client request */
	static const char *headers[] = {
		"apikey: " SUPABASE_ANON_KEY "\r\n",
		"Content-Type: application/json\r\n",
		"Prefer: return=minimal\r\n",
		NULL
	};

	struct rest_client_req_context req;
	struct rest_client_resp_context resp;

	rest_client_request_defaults_set(&req);
	req.host		= SUPABASE_HOST;
	req.port		= SUPABASE_PORT;
	req.url			= SUPABASE_URL;
	req.sec_tag		= TLS_SEC_TAG;
	req.tls_peer_verify	= REST_CLIENT_TLS_DEFAULT_PEER_VERIFY;
	req.http_method		= HTTP_POST;
	req.header_fields	= headers;
	req.body		= body_buf;
	req.body_len		= len;
	req.resp_buff		= resp_buf;
	req.resp_buff_len	= sizeof(resp_buf);
	req.timeout_ms		= 30000;

	printk("POST %s (%d bytes)...\n", SUPABASE_URL, len);

	err = rest_client_request(&req, &resp);
	if (err) {
		printk("rest_client_request failed: %d\n", err);
		return err;
	}

	printk("HTTP %d\n", resp.http_status_code);

	if (resp.http_status_code != 201 && resp.http_status_code != 200) {
		printk("Unexpected status. Body: %.*s\n",
		       (int)resp.response_len, resp.response ? resp.response : "");
		return -EIO;
	}

	return 0;
}

int transport_fetch_config(uint32_t *sample_interval_ms)
{
	int err;

	static const char *headers[] = {
		"apikey: " SUPABASE_ANON_KEY "\r\n",
		NULL
	};

	struct rest_client_req_context req;
	struct rest_client_resp_context resp;

	rest_client_request_defaults_set(&req);
	req.host		= SUPABASE_HOST;
	req.port		= SUPABASE_PORT;
	req.url			= SUPABASE_CONFIG_URL "?select=sample_interval_ms&limit=1";
	req.sec_tag		= TLS_SEC_TAG;
	req.tls_peer_verify	= REST_CLIENT_TLS_DEFAULT_PEER_VERIFY;
	req.http_method		= HTTP_GET;
	req.header_fields	= headers;
	req.body		= NULL;
	req.body_len		= 0;
	req.resp_buff		= resp_buf;
	req.resp_buff_len	= sizeof(resp_buf);
	req.timeout_ms		= 15000;

	printk("GET %s?select=sample_interval_ms&limit=1...\n",
	       SUPABASE_CONFIG_URL);

	err = rest_client_request(&req, &resp);
	if (err) {
		printk("fetch_config: request failed: %d\n", err);
		return err;
	}

	if (resp.http_status_code != 200) {
		printk("fetch_config: HTTP %d\n", resp.http_status_code);
		return -EIO;
	}

	/*
	 * Response is a JSON array, e.g.:
	 *   [{"sample_interval_ms":5000}]   — row found
	 *   []                               — no config row
	 *
	 * Parse by searching for the key and reading the following integer.
	 */
	if (resp.response && resp.response_len > 0) {
		const char *key = "\"sample_interval_ms\":";
		const char *p = strstr(resp.response, key);

		if (p) {
			p += strlen(key);

			/* Parse unsigned decimal integer */
			uint32_t val = 0;

			while (*p >= '0' && *p <= '9') {
				val = val * 10u + (uint32_t)(*p - '0');
				p++;
			}

			/* Sanity: 1 second – 1 hour */
			if (val >= 1000u && val <= 3600000u) {
				*sample_interval_ms = val;
				printk("fetch_config: sample_interval_ms = %u ms\n", val);
			} else {
				printk("fetch_config: value %u out of range, ignoring\n", val);
			}
		} else {
			printk("fetch_config: no config row\n");
		}
	}

	return 0;
}

int transport_send_batch(const struct accel_sample *samples, int count,
			 uint8_t battery_pct)
{
	int err;
	int pos = 0;

	pos += snprintf(batch_buf + pos, sizeof(batch_buf) - pos,
			"{\"battery_pct\":%u,\"x\":[",
			battery_pct);

	for (int i = 0; i < count; i++) {
		pos += snprintf(batch_buf + pos, sizeof(batch_buf) - pos,
			"%s%d", i > 0 ? "," : "", samples[i].x);

		if (pos >= (int)sizeof(batch_buf) - 2) {
			printk("batch_buf overflow at x sample %d\n", i);
			return -ENOMEM;
		}
	}

	pos += snprintf(batch_buf + pos, sizeof(batch_buf) - pos, "],\"y\":[");

	for (int i = 0; i < count; i++) {
		pos += snprintf(batch_buf + pos, sizeof(batch_buf) - pos,
			"%s%d", i > 0 ? "," : "", samples[i].y);

		if (pos >= (int)sizeof(batch_buf) - 2) {
			printk("batch_buf overflow at y sample %d\n", i);
			return -ENOMEM;
		}
	}

	pos += snprintf(batch_buf + pos, sizeof(batch_buf) - pos, "],\"z\":[");

	for (int i = 0; i < count; i++) {
		pos += snprintf(batch_buf + pos, sizeof(batch_buf) - pos,
			"%s%d", i > 0 ? "," : "", samples[i].z);

		if (pos >= (int)sizeof(batch_buf) - 2) {
			printk("batch_buf overflow at z sample %d\n", i);
			return -ENOMEM;
		}
	}

	pos += snprintf(batch_buf + pos, sizeof(batch_buf) - pos, "]}");

	static const char *headers[] = {
		"apikey: " SUPABASE_ANON_KEY "\r\n",
		"Content-Type: application/json\r\n",
		"Prefer: return=minimal\r\n",
		NULL
	};

	struct rest_client_req_context req;
	struct rest_client_resp_context resp;

	rest_client_request_defaults_set(&req);
	req.host		= SUPABASE_HOST;
	req.port		= SUPABASE_PORT;
	req.url			= SUPABASE_URL;
	req.sec_tag		= TLS_SEC_TAG;
	req.tls_peer_verify	= REST_CLIENT_TLS_DEFAULT_PEER_VERIFY;
	req.http_method		= HTTP_POST;
	req.header_fields	= headers;
	req.body		= batch_buf;
	req.body_len		= pos;
	req.resp_buff		= resp_buf;
	req.resp_buff_len	= sizeof(resp_buf);
	req.timeout_ms		= 30000;

	printk("POST %s (%d bytes, %d samples)...\n",
	       SUPABASE_URL, pos, count);

	err = rest_client_request(&req, &resp);
	if (err) {
		printk("batch POST failed: %d\n", err);
		return err;
	}

	printk("HTTP %d\n", resp.http_status_code);

	if (resp.http_status_code != 201 &&
	    resp.http_status_code != 200) {
		printk("Unexpected status. Body: %.*s\n",
		       (int)resp.response_len,
		       resp.response ? resp.response : "");
		return -EIO;
	}

	return 0;
}
```

## src/transport.h
```c
#ifndef TRANSPORT_H
#define TRANSPORT_H

#include <stdint.h>

/**
 * Provision TLS CA certificate into the modem.
 * Must be called after modem init but before LTE connect.
 * Returns 0 on success, negative errno on failure.
 */
int transport_init(void);

/**
 * POST an accelerometer + battery reading to Supabase.
 * Call after LTE is connected.
 *
 * @param x_raw      Raw 14-bit X acceleration count [-8192, +8191]
 * @param y_raw      Raw 14-bit Y acceleration count [-8192, +8191]
 * @param z_raw      Raw 14-bit Z acceleration count [-8192, +8191]
 * Returns 0 on success, negative errno on failure.
 */
int transport_send_reading(int16_t x_raw, int16_t y_raw, int16_t z_raw);

/**
 * Fetch global remote configuration from Supabase node_config table.
 * If a row exists, updates *sample_interval_ms with the cloud value.
 * If no row is found, *sample_interval_ms is left unchanged (caller's default).
 *
 * @param sample_interval_ms  In/out: updated from cloud if a config row is found
 * Returns 0 on success (including "no row found"), negative errno on network error.
 */
int transport_fetch_config(uint32_t *sample_interval_ms);

struct accel_sample {
	int16_t x, y, z;
};

int transport_send_batch(const struct accel_sample *samples, int count,
			 uint8_t battery_pct);

#endif /* TRANSPORT_H */
```
